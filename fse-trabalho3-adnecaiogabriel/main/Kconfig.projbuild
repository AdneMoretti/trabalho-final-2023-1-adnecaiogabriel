## fse-trabalho3-adnecaiogabriel/main/Kconfig.projbuild
```kconfig
menu "Configuração do Wifi"

    config ESP_WIFI_SSID
        string "WiFi SSID"
        default "ssid"
        help
            Nome da rede Wifi.

    config ESP_WIFI_PASSWORD
        string "Senha do Wifi"
        default "minha_senha"
        help
            Senha do WiFi (WPA or WPA2).

    config ESP_MAXIMUM_RETRY
        int "Número máximo de tentativas de conexão"
        default 5
        help
            Configure o valor máximo de tentativas de conexão.
endmenu

menu "Modo de Funcionamento"

    choice ESP_MODE
        prompt "Configure o modo de operação da ESP"
        default ENERGY

        config BATTERY
            bool "Modo de Bateria"
        config ENERGY
            bool "Modo de Energia"
    endchoice
    
    config ESP_MODE
        int
        default 0 if BATTERY
        default 1 if ENERGY

endmenu

menu "Seleção de Configuração de Placa"

  choice ESP_CONFIG_NUMBER
      prompt "Selecione a configuração da ESP"
      default ESP0

      config ESP0
          bool "Sensor de Hall + DHT"
      config ESP1
          bool "Buzzer + Sensor de toque"
      config ESP2
          bool "Sensor de som + LED"
  endchoice

  config ESP_CONFIG_NUMBER
    int
    default 0 if ESP0
    default 1 if ESP1
    default 2 if ESP2
endmenu

menu "Outros"
    config ESP_WIFI_PASSWORD
        string "Senha do Wifi"
        default "minha_senha"
        help
            Senha do WiFi (WPA or WPA2).
endmenu

menu "Example Configuration"
    choice MODO_OTA
        prompt "ativar o modo ota?"
        default desligado
  
        config Desligado
            bool "desligado"
        config Ligado
            bool "ligado"
    endchoice
  
    config MODO_OTA
      int
      default 0 if desligado
      default 1 if ligado


    config EXAMPLE_FIRMWARE_UPGRADE_URL
        string "firmware upgrade url endpoint"
        default "https://192.168.0.3:8070/hello_world.bin"
        help
            URL of server which hosts the firmware
            image.

    config EXAMPLE_USE_CERT_BUNDLE
        bool "Enable certificate bundle"
        default y
        depends on MBEDTLS_CERTIFICATE_BUNDLE
        help
            Enable trusted root certificate bundle. This approach allows to have
            OTA updates functional with any public server without requirement
            to explicitly add its server certificate.

    config EXAMPLE_FIRMWARE_UPGRADE_URL_FROM_STDIN
        bool
        default y if EXAMPLE_FIRMWARE_UPGRADE_URL = "FROM_STDIN"

    config EXAMPLE_SKIP_COMMON_NAME_CHECK
        bool "Skip server certificate CN fieldcheck"
        default n
        help
            This allows you to skip the validation of OTA server certificate CN field.

    config EXAMPLE_FIRMWARE_UPGRADE_BIND_IF
        bool "Support firmware upgrade bind specified interface"
        default n
        help
            This allows you to bind specified interface in OTA example.

    choice EXAMPLE_FIRMWARE_UPGRADE_BIND_IF_TYPE
        prompt "Choose OTA data bind interface"
        default EXAMPLE_FIRMWARE_UPGRADE_BIND_IF_STA
        depends on EXAMPLE_FIRMWARE_UPGRADE_BIND_IF
        help
            Select which interface type of OTA data go through.

        config EXAMPLE_FIRMWARE_UPGRADE_BIND_IF_STA
            bool "Bind wifi station interface"
            depends on EXAMPLE_CONNECT_WIFI
            help
                Select wifi station interface to pass the OTA data.

        config EXAMPLE_FIRMWARE_UPGRADE_BIND_IF_ETH
            bool "Bind ethernet interface"
            depends on EXAMPLE_CONNECT_ETHERNET
            help
                Select ethernet interface to pass the OTA data.
    endchoice
endmenu
```
